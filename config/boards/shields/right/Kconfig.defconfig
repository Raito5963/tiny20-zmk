## config/boards/shields/right/Kconfig.defconfig
```kconfig
# Copyright (c) 2025
# SPDX-License-Identifier: MIT

if SHIELD_RIGHT

config ZMK_KEYBOARD_NAME
	default "Right Keyboard"

endif
```

## zmk-config/config/boards/shields/tiny20/Kconfig.defconfig
```kconfig
if SHIELD_TINY20_LEFT

config ZMK_KEYBOARD_NAME
    default "Tiny20"

config ZMK_SPLIT_BLE_ROLE_CENTRAL
    default y

endif

if SHIELD_TINY20_LEFT || SHIELD_TINY20_RIGHT

config ZMK_SPLIT
    default y 
    
endif
```

## zmk-config/config/boards/shields/tiny20/Kconfig.shield
```kconfig
config SHIELD_TINY20_LEFT
    def_bool $(shields_list_contains,tiny20_left)
config SHIELD_TINY20_RIGHT
    def_bool $(shields_list_contains,tiny20_right)
```
