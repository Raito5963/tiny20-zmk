#include "tiny20.dtsi"

&kscan0 {
    compatible = "zmk,kscan-gpio-direct";
    wakeup-source;
    input-gpios
        = <&xiao_ble 10 (GPIO_ACTIVE_HIGH | GPIO_PULL_DOWN)>
        , <&xiao_ble 9 (GPIO_ACTIVE_HIGH | GPIO_PULL_DOWN)>
        , <&xiao_ble 8 (GPIO_ACTIVE_HIGH | GPIO_PULL_DOWN)>
        , <&xiao_ble 7 (GPIO_ACTIVE_HIGH | GPIO_PULL_DOWN)>
        , <&xiao_ble 6 (GPIO_ACTIVE_HIGH | GPIO_PULL_DOWN)>
        , <&xiao_ble 5 (GPIO_ACTIVE_HIGH | GPIO_PULL_DOWN)>
        , <&xiao_ble 4 (GPIO_ACTIVE_HIGH | GPIO_PULL_DOWN)>
        , <&xiao_ble 3 (GPIO_ACTIVE_HIGH | GPIO_PULL_DOWN)>
        , <&xiao_ble 2 (GPIO_ACTIVE_HIGH | GPIO_PULL_DOWN)>
        , <&xiao_ble 1 (GPIO_ACTIVE_HIGH | GPIO_PULL_DOWN)>
        ;
};